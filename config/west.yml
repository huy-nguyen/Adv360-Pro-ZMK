## config/west.yml
```yaml
manifest:
  remotes:
    - name: zmkfirmware
      url-base: https://github.com/zmkfirmware
    - name: refil
      url-base: https://github.com/refil
  projects:
    - name: zmk
      remote: refil
      revision: 10b605e1b7590ef998385ab29fb0a5d9dc616766
      import: app/west.yml
  self:
    path: config
```
